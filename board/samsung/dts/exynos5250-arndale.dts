/*
 * SAMSUNG Arndale board device tree source
 *
 * Copyright (c) 2013 Samsung Electronics Co., Ltd.
 *		http://www.samsung.com
 *
 * This program is free software; you can redistribute it and/or modify
 * it under the terms of the GNU General Public License version 2 as
 * published by the Free Software Foundation.
*/

/dts-v1/;
/include/ ARCH_CPU_DTS

/ {
	model = "SAMSUNG Arndale board based on EXYNOS5250";
	compatible = "samsung,arndale", "samsung,exynos5250";

	aliases {
		serial0 = "/serial@12C20000";
		console = "/serial@12C20000";
	};
};
